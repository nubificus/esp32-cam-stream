## main/Kconfig.projbuild
```kconfig
menu "Camera Board Selection"

    choice BOARD_CAMERA_MODEL
        prompt "Select camera board"
        default BOARD_ESP32CAM_AITHINKER
        help
            Select the camera board pinout to use.

        config BOARD_ESP32CAM_AITHINKER
            bool "AI Thinker ESP32-CAM"
            help
                AI Thinker ESP32-CAM module (original ESP32 with OV2640).

        config BOARD_ESP32S3_EYE
            bool "ESP32-S3-EYE / GOOUUU ESP32-S3-CAM"
            help
                ESP32-S3-EYE or compatible boards (e.g. GOOUUU ESP32-S3-CAM).
                XCLK=15, VSYNC=6, HREF=7, PCLK=13, SIOD=4, SIOC=5,
                D0-D7=11/9/8/10/12/18/17/16, PWDN=38.

    endchoice

endmenu
```

## sdkconfig.defaults.esp32p4
```kconfig
# ESP32-P4 specific configuration - ESP-IDF 6.0
# ESP32-P4 uses a high-speed MSPI PSRAM controller; SPIRAM_MODE_QUAD/OCT
# do not apply. IDF auto-detects PSRAM geometry on this chip.
# Note: esp32-camera DVP support on P4 requires camera_pins.h updates
#       to use the P4 CSI interface instead of legacy DVP pin mapping.
CONFIG_ESPTOOLPY_FLASHSIZE_16MB=y
CONFIG_SPIRAM=y
CONFIG_SPIRAM_BOOT_INIT=y
CONFIG_SPIRAM_USE_MALLOC=y
CONFIG_SPIRAM_MALLOC_ALWAYSINTERNAL=16384
CONFIG_SPIRAM_MALLOC_RESERVE_INTERNAL=32768
# WiFi via co-processor (esp_hosted + wifi_remote) - ESP32-P4 has no native WiFi.
# espressif/esp_wifi_remote managed component is added to idf_component.yml.
# Selects ESP32-C6 as WiFi co-processor (default for P4-Function-EV-Board).
# Adjust CONFIG_SLAVE_IDF_TARGET_* if your board uses a different co-processor.
CONFIG_SLAVE_IDF_TARGET_ESP32C6=y
```

## sdkconfig.defaults.esp32s3
```kconfig
# ESP32-S3 specific configuration - ESP-IDF 6.0
# For standard S3 and S3-R2 (Quad PSRAM) boards
CONFIG_SPIRAM=y
CONFIG_SPIRAM_MODE_QUAD=y
CONFIG_SPIRAM_TYPE_AUTO=y
CONFIG_SPIRAM_SPEED=80
CONFIG_SPIRAM_BOOT_INIT=y
CONFIG_SPIRAM_USE_MALLOC=y
CONFIG_SPIRAM_MEMTEST=y
CONFIG_SPIRAM_MALLOC_ALWAYSINTERNAL=16384
CONFIG_SPIRAM_MALLOC_RESERVE_INTERNAL=32768
```

## sdkconfig.defaults.esp32s3r8
```kconfig
# ESP32-S3-R8 specific configuration - ESP-IDF 6.0
# For S3-R8 boards with Octal PSRAM (8MB)
CONFIG_SPIRAM=y
CONFIG_SPIRAM_MODE_OCT=y
CONFIG_SPIRAM_TYPE_AUTO=y
CONFIG_SPIRAM_SPEED=80
CONFIG_SPIRAM_BOOT_INIT=y
CONFIG_SPIRAM_USE_MALLOC=y
CONFIG_SPIRAM_MEMTEST=y
CONFIG_SPIRAM_MALLOC_ALWAYSINTERNAL=16384
CONFIG_SPIRAM_MALLOC_RESERVE_INTERNAL=32768
```
